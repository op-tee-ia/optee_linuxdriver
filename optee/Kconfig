## optee/Kconfig
```kconfig
# SPDX-License-Identifier: GPL-2.0-only
# OP-TEE Trusted Execution Environment Configuration
config OPTEE
	tristate "OP-TEE"
	depends on HAVE_ARM_SMCCC || X86_64
	depends on MMU
	help
	  This implements the OP-TEE Trusted Execution Environment (TEE)
	  driver.

config OPTEE_SHM_NUM_PRIV_PAGES
	int "Private Shared Memory Pages"
	default 1
	depends on OPTEE
	help
	  This sets the number of private shared memory pages to be
	  used by OP-TEE TEE driver.

config OPTEE_BENCHMARK
	bool "OP-TEE Benchmark (EXPERIMENTAL)"
	depends on OPTEE
	help
	  This enables benchmarking feature in the OP-TEE Trusted
	  Execution Environment (TEE) driver.

config OPTEE_HV_IKGT
	bool "OP-TEE on top of IKGT hypervisor"
	depends on OPTEE
	depends on X86_64
	help
	  This enables IKGT based SMC in the OP-TEE Trusted
	  Execution Environment (TEE) driver.

config OPTEE_HV_QEMU
	bool "OP-TEE on top of QEMU hypervisor"
	depends on OPTEE
	depends on X86_64
	help
	  This enables QEMU based SMC in the OP-TEE Trusted
	  Execution Environment (TEE) driver.
```
